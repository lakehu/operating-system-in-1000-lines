ENTRY(boot)

SECTIONS {
    . = 0x40200000; /* QEMU virt RAM starts at 0x40000000 */
    __kernel_base = .;

    .text :{
        KEEP(*(.text.boot));
        *(.text .text.*);
    }

    .rodata : ALIGN(4) {
        *(.rodata .rodata.*);
    }

    .data : ALIGN(4) {
        *(.data .data.*);
    }

    .bss : ALIGN(4) {
        __bss = .;
        *(.bss .bss.* .sbss .sbss.*);
        __bss_end = .;
    }

    . = ALIGN(8);
    . += 128 * 1024; /* 128KB */
    __stack_top = .;

    . += 4 * 1024; /* abort/undefined mode stack */
    __exception_stack_top = .;

    . = ALIGN(4096);
    __free_ram = .;
    . += 64 * 1024 * 1024; /* 64MB */
    __free_ram_end = .;
}
